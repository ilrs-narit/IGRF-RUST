## buildroot/Config.in
```kconfig
menu "IGRF kiosk packages"

source "$BR2_EXTERNAL_IGRF_PATH/package/igrf-app/Config.in"
source "$BR2_EXTERNAL_IGRF_PATH/package/onboard/Config.in"
source "$BR2_EXTERNAL_IGRF_PATH/package/python-distutils-extra/Config.in"
source "$BR2_EXTERNAL_IGRF_PATH/package/dconf/Config.in"
source "$BR2_EXTERNAL_IGRF_PATH/package/hunspell/Config.in"
source "$BR2_EXTERNAL_IGRF_PATH/package/iso-codes/Config.in"

endmenu
```

## buildroot/package/dconf/Config.in
```kconfig
config BR2_PACKAGE_DCONF
	bool "dconf"
	depends on BR2_USE_MMU
	depends on BR2_USE_WCHAR
	depends on BR2_TOOLCHAIN_HAS_THREADS
	depends on !BR2_STATIC_LIBS
	select BR2_PACKAGE_LIBGLIB2
	select BR2_PACKAGE_DBUS
	help
	  GSettings backend and system settings database compiler.

	  https://gitlab.gnome.org/GNOME/dconf
```

## buildroot/package/hunspell/Config.in
```kconfig
config BR2_PACKAGE_HUNSPELL
	bool "hunspell"
	depends on BR2_INSTALL_LIBSTDCPP
	depends on BR2_USE_WCHAR
	help
	  Spell checking library used by Onboard.

	  https://hunspell.github.io/
```

## buildroot/package/iso-codes/Config.in
```kconfig
config BR2_PACKAGE_ISO_CODES
	bool "iso-codes"
	help
	  ISO language and country names used by Onboard.

	  https://salsa.debian.org/iso-codes-team/iso-codes
```

## buildroot/package/onboard/Config.in
```kconfig
config BR2_PACKAGE_ONBOARD
	bool "onboard"
	depends on BR2_USE_MMU
	depends on BR2_USE_WCHAR
	depends on BR2_TOOLCHAIN_HAS_THREADS
	depends on BR2_INSTALL_LIBSTDCPP
	depends on !BR2_STATIC_LIBS
	depends on BR2_TOOLCHAIN_HAS_SYNC_4
	depends on BR2_TOOLCHAIN_GCC_AT_LEAST_4_9
	depends on BR2_HOST_GCC_AT_LEAST_8
	depends on BR2_TOOLCHAIN_USES_GLIBC || BR2_TOOLCHAIN_USES_MUSL
	depends on BR2_PACKAGE_GOBJECT_INTROSPECTION_ARCH_SUPPORTS
	depends on BR2_PACKAGE_HOST_RUSTC_TARGET_ARCH_SUPPORTS
	depends on BR2_PACKAGE_HOST_RUSTC_ARCH_SUPPORTS
	depends on BR2_PACKAGE_HAS_UDEV
	depends on BR2_PACKAGE_XORG7
	depends on BR2_PACKAGE_HAS_LIBGL
	select BR2_PACKAGE_PYTHON3
	select BR2_PACKAGE_PYTHON3_PYEXPAT
	select BR2_PACKAGE_PYTHON_PYCAIRO
	select BR2_PACKAGE_DBUS
	select BR2_PACKAGE_DBUS_PYTHON
	select BR2_PACKAGE_PYTHON_GOBJECT
	# Typelib generation executes target Python under host QEMU.
	select BR2_PACKAGE_GOBJECT_INTROSPECTION
	select BR2_PACKAGE_LIBRSVG # SVG keyboard images via GdkPixbuf
	select BR2_PACKAGE_LIBGTK3
	select BR2_PACKAGE_LIBGTK3_X11
	select BR2_PACKAGE_XLIB_LIBX11
	select BR2_PACKAGE_XLIB_LIBXI
	select BR2_PACKAGE_XLIB_LIBXTST
	select BR2_PACKAGE_XLIB_LIBXKBFILE
	select BR2_PACKAGE_LIBCANBERRA
	select BR2_PACKAGE_GSETTINGS_DESKTOP_SCHEMAS
	select BR2_PACKAGE_DCONF
	select BR2_PACKAGE_HUNSPELL
	select BR2_PACKAGE_ISO_CODES
	help
	  X11 touch keyboard controlled by the IGRF app over session D-Bus.
	  Disable GTK3's Wayland backend in the kiosk defconfig.

	  https://github.com/onboard-osk/onboard
```

## buildroot/package/python-distutils-extra/Config.in
```kconfig
config BR2_PACKAGE_PYTHON_DISTUTILS_EXTRA
	bool "python-distutils-extra"
	depends on BR2_PACKAGE_PYTHON3
	select BR2_PACKAGE_PYTHON_SETUPTOOLS
	help
	  Distutils helpers for translations and desktop resources.
	  Onboard uses the host variant at build time.

	  https://salsa.debian.org/python-team/packages/python-distutils-extra
```
